## meta-bsp-exynos/conf/layer.conf
```bitbake
# We have a conf and classes directory, add to BBPATH
BBPATH .= ":${LAYERDIR}"

# We have recipes-* directories, add to BBFILES
BBFILES += "${LAYERDIR}/recipes-*/*/*.bb \
	${LAYERDIR}/recipes-*/*/*.bbappend"

BBFILE_COLLECTIONS += "bsp-exynos"
BBFILE_PATTERN_bsp-exynos = "^${LAYERDIR}/"
BBFILE_PRIORITY_bsp-exynos = "7"
```
